## boards/arm/gt_wheel/Kconfig.board
```kconfig
# DIY Ibakha GT-Wheel board configuration

# Copyright (c) 2020 Paul M. Bendixen
# SPDX-License-Identifier: Apache-2.0

config BOARD_IBA_GT_WHEEL
	bool "Ibakha DIY GT-Wheel Board"
	depends on SOC_STM32F303XE
```

## boards/arm/iba_gt_wheel/Kconfig.defconfig
```kconfig
# DIY Ibakha GT-Wheel board configuration

# Copyright (c) 2020 Paul M. Bendixen
# SPDX-License-Identifier: Apache-2.0

if BOARD_IBA_GT_WHEEL

config BOARD
	default "iba_gt_wheel"

endif # BOARD_IBA_GT_WHEEL
```
